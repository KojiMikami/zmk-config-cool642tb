## config/west.yml
```yaml
manifest:
  remotes:
    - name: zmkfirmware
      url_base: https://github.com/zmkfirmware
  projects:
    - name: zmk
      remote: zmkfirmware
      revision: v3.2.0
      import: app/west.yml
  self:
    path: config
```
